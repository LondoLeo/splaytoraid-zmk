## config/west.yml
```yaml
manifest:
  remotes:
    - name: zmk
      url-base: https://github.com/LondoLeo
  projects:
    - name: zmk
      remote: zmk
      revision: main
  self:
    path: config
```
